## node-webrtc/conf/layer.conf
```bitbake
# We have a conf and classes directory, add to BBPATH
BBPATH .= ":${LAYERDIR}"

# We have a packages directory, add to BBFILES
BBFILES += "${LAYERDIR}/recipe-*/*.bb \
            ${LAYERDIR}/recipe-*/*.bbappend"

BBFILE_COLLECTIONS += "daiane"
BBFILE_PATTERN_daiane := "^${LAYERDIR}/"
BBFILE_PRIORITY_daiane = "4"
```
